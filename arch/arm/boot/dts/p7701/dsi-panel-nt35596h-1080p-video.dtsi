/* Copyright (c) 2013-2015, The Linux Foundation. All rights reserved.
 *
 * This program is free software; you can redistribute it and/or modify
 * it under the terms of the GNU General Public License version 2 and
 * only version 2 as published by the Free Software Foundation.
 *
 * This program is distributed in the hope that it will be useful,
 * but WITHOUT ANY WARRANTY; without even the implied warranty of
 * MERCHANTABILITY or FITNESS FOR A PARTICULAR PURPOSE.  See the
 * GNU General Public License for more details.
 */

&mdss_mdp {
	dsi_nt35596h_1080p_video: qcom,mdss_dsi_nt35596h_1080p_vdo {
		qcom,mdss-dsi-panel-name = "nt35596h 1080p video mode dsi panel";
		qcom,mdss-dsi-panel-controller = <&mdss_dsi0>;
		qcom,mdss-dsi-panel-type = "dsi_video_mode";
		qcom,mdss-dsi-panel-destination = "display_1";
		qcom,mdss-dsi-panel-framerate = <60>;
		qcom,mdss-dsi-virtual-channel-id = <0>;
		qcom,mdss-dsi-stream = <0>;
		qcom,mdss-dsi-panel-width = <1080>;
		qcom,mdss-dsi-panel-height = <1920>;
		qcom,mdss-dsi-h-front-porch = <45>;
		qcom,mdss-dsi-h-back-porch = <45>;
		qcom,mdss-dsi-h-pulse-width = <8>;
		qcom,mdss-dsi-h-sync-skew = <0>;
		qcom,mdss-dsi-v-back-porch = <6>;
		qcom,mdss-dsi-v-front-porch = <16>;
		qcom,mdss-dsi-v-pulse-width = <6>;
		qcom,mdss-dsi-h-left-border = <0>;
		qcom,mdss-dsi-h-right-border = <0>;
		qcom,mdss-dsi-v-top-border = <0>;
		qcom,mdss-dsi-v-bottom-border = <0>;
		qcom,mdss-dsi-bpp = <24>;
		qcom,mdss-dsi-underflow-color = <255>;
		qcom,mdss-dsi-border-color = <0>;
		qcom,mdss-dsi-on-command = [15 01 00 00 00 00 02 ff 05 15 01 00 00 00 00 02 fb 01 15 01 00 00 00 00 02 c5 31 15 01 00 00 00 00 02 ff ee 15 01 00 00 00 00 02 fb 01 15 01 00 00 14 00 02 18 40 15 01 00 00 0a 00 02 18 00 15 01 00 00 00 00 02 ff ee 15 01 00 00 00 00 02 7c 31 15 01 00 00 00 00 02 fb 01 15 01 00 00 00 00 02 ff 01 15 01 00 00 00 00 02 30 0f 15 01 00 00 00 00 02 00 01 15 01 00 00 00 00 02 01 55 15 01 00 00 00 00 02 02 40 15 01 00 00 00 00 02 05 50 15 01 00 00 00 00 02 06 4a 15 01 00 00 00 00 02 07 29 15 01 00 00 00 00 02 08 0c 15 01 00 00 00 00 02 0b 73 15 01 00 00 00 00 02 0c 73 15 01 00 00 00 00 02 0e b0 15 01 00 00 00 00 02 0f ae 15 01 00 00 00 00 02 13 03 15 01 00 00 00 00 02 14 4a 15 01 00 00 00 00 02 15 12 15 01 00 00 00 00 02 16 12 15 01 00 00 00 00 02 18 00 15 01 00 00 00 00 02 19 77 15 01 00 00 00 00 02 1a 55 15 01 00 00 00 00 02 1b 13 15 01 00 00 00 00 02 1c 00 15 01 00 00 00 00 02 1d 00 15 01 00 00 00 00 02 1e 00 15 01 00 00 00 00 02 1f 00 15 01 00 00 00 00 02 58 82 15 01 00 00 00 00 02 59 02 15 01 00 00 00 00 02 5a 02 15 01 00 00 00 00 02 5b 02 15 01 00 00 00 00 02 5c 82 15 01 00 00 00 00 02 5d 82 15 01 00 00 00 00 02 5e 02 15 01 00 00 00 00 02 5f 02 15 01 00 00 00 00 02 72 31 15 01 00 00 00 00 02 fb 01 15 01 00 00 00 00 02 ff 05 15 01 00 00 00 00 02 00 01 15 01 00 00 00 00 02 01 0b 15 01 00 00 00 00 02 02 0c 15 01 00 00 00 00 02 03 09 15 01 00 00 00 00 02 04 0a 15 01 00 00 00 00 02 05 00 15 01 00 00 00 00 02 06 0f 15 01 00 00 00 00 02 07 10 15 01 00 00 00 00 02 08 1a 15 01 00 00 00 00 02 09 00 15 01 00 00 00 00 02 0a 00 15 01 00 00 00 00 02 0b 00 15 01 00 00 00 00 02 0c 00 15 01 00 00 00 00 02 0d 13 15 01 00 00 00 00 02 0e 15 15 01 00 00 00 00 02 0f 17 15 01 00 00 00 00 02 10 01 15 01 00 00 00 00 02 11 0b 15 01 00 00 00 00 02 12 0c 15 01 00 00 00 00 02 13 09 15 01 00 00 00 00 02 14 0a 15 01 00 00 00 00 02 15 00 15 01 00 00 00 00 02 16 0f 15 01 00 00 00 00 02 17 10 15 01 00 00 00 00 02 18 1a 15 01 00 00 00 00 02 19 00 15 01 00 00 00 00 02 1a 00 15 01 00 00 00 00 02 1b 00 15 01 00 00 00 00 02 1c 00 15 01 00 00 00 00 02 1d 13 15 01 00 00 00 00 02 1e 15 15 01 00 00 00 00 02 1f 17 15 01 00 00 00 00 02 20 00 15 01 00 00 00 00 02 21 01 15 01 00 00 00 00 02 22 00 15 01 00 00 00 00 02 23 40 15 01 00 00 00 00 02 24 40 15 01 00 00 00 00 02 25 6d 15 01 00 00 00 00 02 29 d8 15 01 00 00 00 00 02 2a 2a 15 01 00 00 00 00 02 2b 00 15 01 00 00 00 00 02 b6 89 15 01 00 00 00 00 02 b7 14 15 01 00 00 00 00 02 b8 05 15 01 00 00 00 00 02 4b 04 15 01 00 00 00 00 02 4c 11 15 01 00 00 00 00 02 4d 10 15 01 00 00 00 00 02 4e 01 15 01 00 00 00 00 02 4f 01 15 01 00 00 00 00 02 50 10 15 01 00 00 00 00 02 51 00 15 01 00 00 00 00 02 52 00 15 01 00 00 00 00 02 53 08 15 01 00 00 00 00 02 54 01 15 01 00 00 00 00 02 55 6d 15 01 00 00 00 00 02 5b 44 15 01 00 00 00 00 02 5c 00 15 01 00 00 00 00 02 5f 74 15 01 00 00 00 00 02 60 75 15 01 00 00 00 00 02 63 ff 15 01 00 00 00 00 02 64 00 15 01 00 00 00 00 02 67 04 15 01 00 00 00 00 02 68 04 15 01 00 00 00 00 02 6c 00 15 01 00 00 00 00 02 7a 80 15 01 00 00 00 00 02 7b 91 15 01 00 00 00 00 02 7c d8 15 01 00 00 00 00 02 7d 60 15 01 00 00 00 00 02 7f 15 15 01 00 00 00 00 02 80 00 15 01 00 00 00 00 02 83 00 15 01 00 00 00 00 02 93 08 15 01 00 00 00 00 02 94 0a 15 01 00 00 00 00 02 8a 00 15 01 00 00 00 00 02 9b 0f 15 01 00 00 00 00 02 ff 01 15 01 00 00 00 00 02 fb 01 15 01 00 00 00 00 02 75 00 15 01 00 00 00 00 02 76 03 15 01 00 00 00 00 02 77 00 15 01 00 00 00 00 02 78 1d 15 01 00 00 00 00 02 79 00 15 01 00 00 00 00 02 7a 41 15 01 00 00 00 00 02 7b 00 15 01 00 00 00 00 02 7c 5e 15 01 00 00 00 00 02 7d 00 15 01 00 00 00 00 02 7e 76 15 01 00 00 00 00 02 7f 00 15 01 00 00 00 00 02 80 8a 15 01 00 00 00 00 02 81 00 15 01 00 00 00 00 02 82 9e 15 01 00 00 00 00 02 83 00 15 01 00 00 00 00 02 84 af 15 01 00 00 00 00 02 85 00 15 01 00 00 00 00 02 86 be 15 01 00 00 00 00 02 87 00 15 01 00 00 00 00 02 88 f1 15 01 00 00 00 00 02 89 01 15 01 00 00 00 00 02 8a 1a 15 01 00 00 00 00 02 8b 01 15 01 00 00 00 00 02 8c 57 15 01 00 00 00 00 02 8d 01 15 01 00 00 00 00 02 8e 8c 15 01 00 00 00 00 02 8f 01 15 01 00 00 00 00 02 90 d9 15 01 00 00 00 00 02 91 02 15 01 00 00 00 00 02 92 14 15 01 00 00 00 00 02 93 02 15 01 00 00 00 00 02 94 17 15 01 00 00 00 00 02 95 02 15 01 00 00 00 00 02 96 47 15 01 00 00 00 00 02 97 02 15 01 00 00 00 00 02 98 80 15 01 00 00 00 00 02 99 02 15 01 00 00 00 00 02 9a aa 15 01 00 00 00 00 02 9b 02 15 01 00 00 00 00 02 9c da 15 01 00 00 00 00 02 9d 02 15 01 00 00 00 00 02 9e fa 15 01 00 00 00 00 02 9f 03 15 01 00 00 00 00 02 a0 2a 15 01 00 00 00 00 02 a2 03 15 01 00 00 00 00 02 a3 34 15 01 00 00 00 00 02 a4 03 15 01 00 00 00 00 02 a5 44 15 01 00 00 00 00 02 a6 03 15 01 00 00 00 00 02 a7 56 15 01 00 00 00 00 02 a9 03 15 01 00 00 00 00 02 aa 66 15 01 00 00 00 00 02 ab 03 15 01 00 00 00 00 02 ac 78 15 01 00 00 00 00 02 ad 03 15 01 00 00 00 00 02 ae a5 15 01 00 00 00 00 02 af 03 15 01 00 00 00 00 02 b0 e8 15 01 00 00 00 00 02 b1 03 15 01 00 00 00 00 02 b2 f8 15 01 00 00 00 00 02 b3 00 15 01 00 00 00 00 02 b4 03 15 01 00 00 00 00 02 b5 00 15 01 00 00 00 00 02 b6 1d 15 01 00 00 00 00 02 b7 00 15 01 00 00 00 00 02 b8 41 15 01 00 00 00 00 02 b9 00 15 01 00 00 00 00 02 ba 5e 15 01 00 00 00 00 02 bb 00 15 01 00 00 00 00 02 bc 76 15 01 00 00 00 00 02 bd 00 15 01 00 00 00 00 02 be 8a 15 01 00 00 00 00 02 bf 00 15 01 00 00 00 00 02 c0 9e 15 01 00 00 00 00 02 c1 00 15 01 00 00 00 00 02 c2 af 15 01 00 00 00 00 02 c3 00 15 01 00 00 00 00 02 c4 be 15 01 00 00 00 00 02 c5 00 15 01 00 00 00 00 02 c6 f1 15 01 00 00 00 00 02 c7 01 15 01 00 00 00 00 02 c8 1a 15 01 00 00 00 00 02 c9 01 15 01 00 00 00 00 02 ca 57 15 01 00 00 00 00 02 cb 01 15 01 00 00 00 00 02 cc 8c 15 01 00 00 00 00 02 cd 01 15 01 00 00 00 00 02 ce d9 15 01 00 00 00 00 02 cf 02 15 01 00 00 00 00 02 d0 14 15 01 00 00 00 00 02 d1 02 15 01 00 00 00 00 02 d2 17 15 01 00 00 00 00 02 d3 02 15 01 00 00 00 00 02 d4 47 15 01 00 00 00 00 02 d5 02 15 01 00 00 00 00 02 d6 80 15 01 00 00 00 00 02 d7 02 15 01 00 00 00 00 02 d8 aa 15 01 00 00 00 00 02 d9 02 15 01 00 00 00 00 02 da da 15 01 00 00 00 00 02 db 02 15 01 00 00 00 00 02 dc fa 15 01 00 00 00 00 02 dd 03 15 01 00 00 00 00 02 de 2a 15 01 00 00 00 00 02 df 03 15 01 00 00 00 00 02 e0 34 15 01 00 00 00 00 02 e1 03 15 01 00 00 00 00 02 e2 44 15 01 00 00 00 00 02 e3 03 15 01 00 00 00 00 02 e4 56 15 01 00 00 00 00 02 e5 03 15 01 00 00 00 00 02 e6 66 15 01 00 00 00 00 02 e7 03 15 01 00 00 00 00 02 e8 78 15 01 00 00 00 00 02 e9 03 15 01 00 00 00 00 02 ea a5 15 01 00 00 00 00 02 eb 03 15 01 00 00 00 00 02 ec e8 15 01 00 00 00 00 02 ed 03 15 01 00 00 00 00 02 ee f8 15 01 00 00 00 00 02 ef 00 15 01 00 00 00 00 02 f0 03 15 01 00 00 00 00 02 f1 00 15 01 00 00 00 00 02 f2 1d 15 01 00 00 00 00 02 f3 00 15 01 00 00 00 00 02 f4 41 15 01 00 00 00 00 02 f5 00 15 01 00 00 00 00 02 f6 5e 15 01 00 00 00 00 02 f7 00 15 01 00 00 00 00 02 f8 76 15 01 00 00 00 00 02 f9 00 15 01 00 00 00 00 02 fa 8a 15 01 00 00 00 00 02 ff 02 15 01 00 00 00 00 02 fb 01 15 01 00 00 00 00 02 00 00 15 01 00 00 00 00 02 01 9e 15 01 00 00 00 00 02 02 00 15 01 00 00 00 00 02 03 af 15 01 00 00 00 00 02 04 00 15 01 00 00 00 00 02 05 be 15 01 00 00 00 00 02 06 00 15 01 00 00 00 00 02 07 f1 15 01 00 00 00 00 02 08 01 15 01 00 00 00 00 02 09 1a 15 01 00 00 00 00 02 0a 01 15 01 00 00 00 00 02 0b 57 15 01 00 00 00 00 02 0c 01 15 01 00 00 00 00 02 0d 8c 15 01 00 00 00 00 02 0e 01 15 01 00 00 00 00 02 0f d9 15 01 00 00 00 00 02 10 02 15 01 00 00 00 00 02 11 14 15 01 00 00 00 00 02 12 02 15 01 00 00 00 00 02 13 17 15 01 00 00 00 00 02 14 02 15 01 00 00 00 00 02 15 47 15 01 00 00 00 00 02 16 02 15 01 00 00 00 00 02 17 80 15 01 00 00 00 00 02 18 02 15 01 00 00 00 00 02 19 aa 15 01 00 00 00 00 02 1a 02 15 01 00 00 00 00 02 1b da 15 01 00 00 00 00 02 1c 02 15 01 00 00 00 00 02 1d fa 15 01 00 00 00 00 02 1e 03 15 01 00 00 00 00 02 1f 2a 15 01 00 00 00 00 02 20 03 15 01 00 00 00 00 02 21 34 15 01 00 00 00 00 02 22 03 15 01 00 00 00 00 02 23 44 15 01 00 00 00 00 02 24 03 15 01 00 00 00 00 02 25 56 15 01 00 00 00 00 02 26 03 15 01 00 00 00 00 02 27 66 15 01 00 00 00 00 02 28 03 15 01 00 00 00 00 02 29 78 15 01 00 00 00 00 02 2a 03 15 01 00 00 00 00 02 2b a5 15 01 00 00 00 00 02 2d 03 15 01 00 00 00 00 02 2f e8 15 01 00 00 00 00 02 30 03 15 01 00 00 00 00 02 31 f8 15 01 00 00 00 00 02 32 00 15 01 00 00 00 00 02 33 03 15 01 00 00 00 00 02 34 00 15 01 00 00 00 00 02 35 1d 15 01 00 00 00 00 02 36 00 15 01 00 00 00 00 02 37 41 15 01 00 00 00 00 02 38 00 15 01 00 00 00 00 02 39 5e 15 01 00 00 00 00 02 3a 00 15 01 00 00 00 00 02 3b 76 15 01 00 00 00 00 02 3d 00 15 01 00 00 00 00 02 3f 8a 15 01 00 00 00 00 02 40 00 15 01 00 00 00 00 02 41 9e 15 01 00 00 00 00 02 42 00 15 01 00 00 00 00 02 43 af 15 01 00 00 00 00 02 44 00 15 01 00 00 00 00 02 45 be 15 01 00 00 00 00 02 46 00 15 01 00 00 00 00 02 47 f1 15 01 00 00 00 00 02 48 01 15 01 00 00 00 00 02 49 1a 15 01 00 00 00 00 02 4a 01 15 01 00 00 00 00 02 4b 57 15 01 00 00 00 00 02 4c 01 15 01 00 00 00 00 02 4d 8c 15 01 00 00 00 00 02 4e 01 15 01 00 00 00 00 02 4f d9 15 01 00 00 00 00 02 50 02 15 01 00 00 00 00 02 51 14 15 01 00 00 00 00 02 52 02 15 01 00 00 00 00 02 53 17 15 01 00 00 00 00 02 54 02 15 01 00 00 00 00 02 55 47 15 01 00 00 00 00 02 56 02 15 01 00 00 00 00 02 58 80 15 01 00 00 00 00 02 59 02 15 01 00 00 00 00 02 5a aa 15 01 00 00 00 00 02 5b 02 15 01 00 00 00 00 02 5c da 15 01 00 00 00 00 02 5d 02 15 01 00 00 00 00 02 5e fa 15 01 00 00 00 00 02 5f 03 15 01 00 00 00 00 02 60 2a 15 01 00 00 00 00 02 61 03 15 01 00 00 00 00 02 62 34 15 01 00 00 00 00 02 63 03 15 01 00 00 00 00 02 64 44 15 01 00 00 00 00 02 65 03 15 01 00 00 00 00 02 66 56 15 01 00 00 00 00 02 67 03 15 01 00 00 00 00 02 68 66 15 01 00 00 00 00 02 69 03 15 01 00 00 00 00 02 6a 78 15 01 00 00 00 00 02 6b 03 15 01 00 00 00 00 02 6c a5 15 01 00 00 00 00 02 6d 03 15 01 00 00 00 00 02 6e e8 15 01 00 00 00 00 02 6f 03 15 01 00 00 00 00 02 70 f8 15 01 00 00 00 00 02 71 00 15 01 00 00 00 00 02 72 03 15 01 00 00 00 00 02 73 00 15 01 00 00 00 00 02 74 1d 15 01 00 00 00 00 02 75 00 15 01 00 00 00 00 02 76 41 15 01 00 00 00 00 02 77 00 15 01 00 00 00 00 02 78 5e 15 01 00 00 00 00 02 79 00 15 01 00 00 00 00 02 7a 76 15 01 00 00 00 00 02 7b 00 15 01 00 00 00 00 02 7c 8a 15 01 00 00 00 00 02 7d 00 15 01 00 00 00 00 02 7e 9e 15 01 00 00 00 00 02 7f 00 15 01 00 00 00 00 02 80 af 15 01 00 00 00 00 02 81 00 15 01 00 00 00 00 02 82 be 15 01 00 00 00 00 02 83 00 15 01 00 00 00 00 02 84 f1 15 01 00 00 00 00 02 85 01 15 01 00 00 00 00 02 86 1a 15 01 00 00 00 00 02 87 01 15 01 00 00 00 00 02 88 57 15 01 00 00 00 00 02 89 01 15 01 00 00 00 00 02 8a 8c 15 01 00 00 00 00 02 8b 01 15 01 00 00 00 00 02 8c d9 15 01 00 00 00 00 02 8d 02 15 01 00 00 00 00 02 8e 14 15 01 00 00 00 00 02 8f 02 15 01 00 00 00 00 02 90 17 15 01 00 00 00 00 02 91 02 15 01 00 00 00 00 02 92 47 15 01 00 00 00 00 02 93 02 15 01 00 00 00 00 02 94 80 15 01 00 00 00 00 02 95 02 15 01 00 00 00 00 02 96 aa 15 01 00 00 00 00 02 97 02 15 01 00 00 00 00 02 98 da 15 01 00 00 00 00 02 99 02 15 01 00 00 00 00 02 9a fa 15 01 00 00 00 00 02 9b 03 15 01 00 00 00 00 02 9c 2a 15 01 00 00 00 00 02 9d 03 15 01 00 00 00 00 02 9e 34 15 01 00 00 00 00 02 9f 03 15 01 00 00 00 00 02 a0 44 15 01 00 00 00 00 02 a2 03 15 01 00 00 00 00 02 a3 56 15 01 00 00 00 00 02 a4 03 15 01 00 00 00 00 02 a5 66 15 01 00 00 00 00 02 a6 03 15 01 00 00 00 00 02 a7 78 15 01 00 00 00 00 02 a9 03 15 01 00 00 00 00 02 aa a5 15 01 00 00 00 00 02 ab 03 15 01 00 00 00 00 02 ac e8 15 01 00 00 00 00 02 ad 03 15 01 00 00 00 00 02 ae f8 15 01 00 00 00 00 02 af 00 15 01 00 00 00 00 02 b0 03 15 01 00 00 00 00 02 b1 00 15 01 00 00 00 00 02 b2 1d 15 01 00 00 00 00 02 b3 00 15 01 00 00 00 00 02 b4 41 15 01 00 00 00 00 02 b5 00 15 01 00 00 00 00 02 b6 5e 15 01 00 00 00 00 02 b7 00 15 01 00 00 00 00 02 b8 76 15 01 00 00 00 00 02 b9 00 15 01 00 00 00 00 02 ba 8a 15 01 00 00 00 00 02 bb 00 15 01 00 00 00 00 02 bc 9e 15 01 00 00 00 00 02 bd 00 15 01 00 00 00 00 02 be af 15 01 00 00 00 00 02 bf 00 15 01 00 00 00 00 02 c0 be 15 01 00 00 00 00 02 c1 00 15 01 00 00 00 00 02 c2 f1 15 01 00 00 00 00 02 c3 01 15 01 00 00 00 00 02 c4 1a 15 01 00 00 00 00 02 c5 01 15 01 00 00 00 00 02 c6 57 15 01 00 00 00 00 02 c7 01 15 01 00 00 00 00 02 c8 8c 15 01 00 00 00 00 02 c9 01 15 01 00 00 00 00 02 ca d9 15 01 00 00 00 00 02 cb 02 15 01 00 00 00 00 02 cc 14 15 01 00 00 00 00 02 cd 02 15 01 00 00 00 00 02 ce 17 15 01 00 00 00 00 02 cf 02 15 01 00 00 00 00 02 d0 47 15 01 00 00 00 00 02 d1 02 15 01 00 00 00 00 02 d2 80 15 01 00 00 00 00 02 d3 02 15 01 00 00 00 00 02 d4 aa 15 01 00 00 00 00 02 d5 02 15 01 00 00 00 00 02 d6 da 15 01 00 00 00 00 02 d7 02 15 01 00 00 00 00 02 d8 fa 15 01 00 00 00 00 02 d9 03 15 01 00 00 00 00 02 da 2a 15 01 00 00 00 00 02 db 03 15 01 00 00 00 00 02 dc 34 15 01 00 00 00 00 02 dd 03 15 01 00 00 00 00 02 de 44 15 01 00 00 00 00 02 df 03 15 01 00 00 00 00 02 e0 56 15 01 00 00 00 00 02 e1 03 15 01 00 00 00 00 02 e2 66 15 01 00 00 00 00 02 e3 03 15 01 00 00 00 00 02 e4 78 15 01 00 00 00 00 02 e5 03 15 01 00 00 00 00 02 e6 a5 15 01 00 00 00 00 02 e7 03 15 01 00 00 00 00 02 e8 e8 15 01 00 00 00 00 02 e9 03 15 01 00 00 00 00 02 ea f8 15 01 00 00 00 00 02 ff 05 15 01 00 00 00 00 02 fb 01 15 01 00 00 00 00 02 e7 80 15 01 00 00 00 00 02 fb 01 15 01 00 00 00 00 02 ec 00 15 01 00 00 00 00 02 ff 00 15 01 00 00 00 00 02 d3 0c 15 01 00 00 00 00 02 d4 06 15 01 00 00 00 00 02 ff 00 15 01 00 00 00 00 02 35 00 15 01 00 00 00 00 02 36 c0 05 01 00 00 c8 00 02 11 00 05 01 00 00 32 00 02 29 00];
		qcom,mdss-dsi-off-command = [05 01 00 00 00 00 02 28 00 05 01 00 00 78 00 02 10 00];
		qcom,mdss-dsi-on-command-state = "dsi_lp_mode";
		qcom,mdss-dsi-off-command-state = "dsi_hs_mode";
		qcom,esd-check-enabled;
		qcom,mdss-dsi-panel-status-command = [06 01 00 01 05 00 02 0a 08];
		qcom,mdss-dsi-panel-status-command-state = "dsi_lp_mode";
		qcom,mdss-dsi-panel-status-check-mode = "reg_read";
		qcom,mdss-dsi-panel-status-read-length = <1>;
		qcom,mdss-dsi-panel-status-value = <156>;
		qcom,mdss-dsi-h-sync-pulse = <1>;
		qcom,mdss-dsi-traffic-mode = "burst_mode";
		qcom,mdss-dsi-lane-map = "lane_map_0123";
		qcom,mdss-dsi-bllp-eof-power-mode;
		qcom,mdss-dsi-bllp-power-mode;
		qcom,mdss-dsi-lp11-init;
		qcom,mdss-dsi-init-delay-us = <5>;
		qcom,mdss-dsi-lane-0-state;
		qcom,mdss-dsi-lane-1-state;
		qcom,mdss-dsi-lane-2-state;
		qcom,mdss-dsi-lane-3-state;
		qcom,mdss-dsi-te-pin-select = <1>;
		qcom,mdss-dsi-wr-mem-start = <44>;
		qcom,mdss-dsi-te-dcs-command = <1>;
		qcom,mdss-dsi-te-check-enable;
		qcom,mdss-dsi-te-using-te-pin;
		qcom,mdss-dsi-panel-timings = <0x6e3f3600 0x5a4f3841 0x54030400>;
		qcom,mdss-dsi-t-clk-post = <30>;
		qcom,mdss-dsi-t-clk-pre = <48>;
		qcom,mdss-dsi-bl-pmic-pwm-frequency = <100>;
		qcom,mdss-dsi-bl-pmic-bank-select = <0>;
		qcom,mdss-dsi-dma-trigger = "trigger_sw";
		qcom,mdss-dsi-mdp-trigger = "none";
		qcom,mdss-dsi-bl-pmic-control-type = "bl_ctrl_wled";
		qcom,mdss-dsi-bl-min-level = <1>;
		qcom,mdss-dsi-bl-max-level = <4095>;
		qcom,mdss-dsi-reset-sequence = <0x1 0x14 0x0 0x5 0x1 0x14>;
	};
};

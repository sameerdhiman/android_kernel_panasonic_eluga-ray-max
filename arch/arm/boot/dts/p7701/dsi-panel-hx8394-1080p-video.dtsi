/* Copyright (c) 2015-2016, The Linux Foundation. All rights reserved.
 *
 * This program is free software; you can redistribute it and/or modify
 * it under the terms of the GNU General Public License version 2 and
 * only version 2 as published by the Free Software Foundation.
 *
 * This program is distributed in the hope that it will be useful,
 * but WITHOUT ANY WARRANTY; without even the implied warranty of
 * MERCHANTABILITY or FITNESS FOR A PARTICULAR PURPOSE.  See the
 * GNU General Public License for more details.
 */

&mdss_mdp {
	dsi_hx8394_1080p_video: qcom,mdss_dsi_hx8394_1080p_video_a_si_boe_p7701 {
		qcom,mdss-dsi-panel-name = "ili9885_hx8394_video_a_si_boe_p7701";
		qcom,mdss-dsi-panel-controller = <&mdss_dsi0>;
		qcom,mdss-dsi-panel-type = "dsi_video_mode";
		qcom,mdss-dsi-panel-destination = "display_1";
		qcom,mdss-dsi-panel-framerate = <60>;
		qcom,mdss-dsi-virtual-channel-id = <0>;
		qcom,mdss-dsi-stream = <0>;
		qcom,mdss-dsi-panel-width = <1080>;
		qcom,mdss-dsi-panel-height = <1920>;
		qcom,mdss-dsi-h-front-porch = <45>;
		qcom,mdss-dsi-h-back-porch = <45>;
		qcom,mdss-dsi-h-pulse-width = <8>;
		qcom,mdss-dsi-h-sync-skew = <0>;
		qcom,mdss-dsi-v-back-porch = <18>;
		qcom,mdss-dsi-v-front-porch = <4>;
		qcom,mdss-dsi-v-pulse-width = <4>;
		qcom,mdss-dsi-h-left-border = <0>;
		qcom,mdss-dsi-h-right-border = <0>;
		qcom,mdss-dsi-v-top-border = <0>;
		qcom,mdss-dsi-v-bottom-border = <0>;
		qcom,mdss-dsi-bpp = <24>;
		qcom,mdss-dsi-color-order = "rgb_swap_rgb";
		qcom,mdss-dsi-underflow-color = <255>;
		qcom,mdss-dsi-border-color = <0>;
		qcom,mdss-dsi-on-command = [29 01 00 00 00 00 04 b9 ff 83 98 29 01 00 00 00 00 0c b1 28 11 91 01 02 33 33 33 cd 43 0d 15 01 00 00 00 00 02 d2 44 29 01 00 00 00 00 0a b2 40 80 ae 0c 12 45 01 11 00 29 01 00 00 00 00 1a b4 00 ff 14 84 14 84 00 00 07 07 a6 00 07 3a 14 84 14 84 00 00 07 07 a6 3a 00 15 01 00 00 00 00 02 bd 02 29 01 00 00 00 00 04 d3 00 04 10 15 01 00 00 00 00 02 bd 00 29 01 00 00 00 00 30 d3 20 00 00 00 00 00 00 00 08 00 32 10 09 00 09 00 00 00 00 00 00 00 00 00 00 33 00 0b 0b 37 00 00 00 10 40 00 07 13 00 00 00 62 99 07 13 62 99 29 01 00 00 00 00 29 d5 18 18 19 19 22 23 20 21 19 19 02 03 02 03 00 01 00 01 06 07 06 07 04 05 04 05 18 18 18 18 18 18 18 18 18 18 18 18 18 18 29 01 00 00 00 00 29 d6 18 18 19 19 21 20 23 22 18 18 05 04 05 04 07 06 07 06 01 00 01 00 03 02 03 02 19 19 18 18 18 18 18 18 18 18 18 18 18 18 15 01 00 00 00 00 02 cc 0e 29 01 00 00 00 00 3b e0 0e 10 17 1c 1e 22 26 21 44 50 5c 5a 5b 68 6a 6c 7c 80 80 92 a7 50 4e 53 59 5c 63 71 7a 04 08 13 16 19 1d 1f 21 41 53 64 64 6e 7a 7c 7c 8a 92 92 a4 b9 5e 5e 61 65 65 6d 7b 7f 15 01 00 00 78 00 02 11 00 15 01 00 00 32 00 02 29 00];
		qcom,mdss-dsi-off-command = [05 01 00 00 32 00 02 28 00 05 01 00 00 78 00 02 10 00];
		qcom,mdss-dsi-on-command-state = "dsi_lp_mode";
		qcom,mdss-dsi-off-command-state = "dsi_hs_mode";
		qcom,esd-check-enabled;
		qcom,mdss-dsi-panel-status-check-mode = "reg_read";
		qcom,mdss-dsi-panel-status-command-state = "dsi_lp_mode";
		qcom,mdss-dsi-panel-status-command = <0x14010001 0x500010a>;
		qcom,mdss-dsi-panel-status-read-length = <1>;
		qcom,mdss-dsi-panel-status-value = <156>;
		qcom,mdss-dsi-h-sync-pulse = <1>;
		qcom,mdss-dsi-traffic-mode = "burst_mode";
		qcom,mdss-dsi-lane-map = "lane_map_0123";
		qcom,mdss-dsi-bllp-eof-power-mode;
		qcom,mdss-dsi-bllp-power-mode;
		qcom,mdss-dsi-lane-0-state;
		qcom,mdss-dsi-lane-1-state;
		qcom,mdss-dsi-lane-2-state;
		qcom,mdss-dsi-lane-3-state;
		qcom,mdss-dsi-panel-timings = <0x6f362400 0x666a2a3a 0x2d030400>;
		qcom,mdss-dsi-t-clk-post = <30>;
		qcom,mdss-dsi-t-clk-pre = <56>;
		qcom,mdss-dsi-bl-min-level = <1>;
		qcom,mdss-dsi-bl-max-level = <4095>;
		qcom,mdss-dsi-dma-trigger = "trigger_sw";
		qcom,mdss-dsi-mdp-trigger = "none";
		qcom,mdss-dsi-bl-pmic-control-type = "bl_ctrl_wled";
		qcom,mdss-dsi-reset-sequence = <0x1 0x14 0x0 0x14 0x1 0x78>;
	};
};

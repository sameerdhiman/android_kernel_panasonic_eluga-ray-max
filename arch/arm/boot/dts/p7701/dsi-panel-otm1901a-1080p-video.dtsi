/* Copyright (c) 2015-2016, The Linux Foundation. All rights reserved.
 *
 * This program is free software; you can redistribute it and/or modify
 * it under the terms of the GNU General Public License version 2 and
 * only version 2 as published by the Free Software Foundation.
 *
 * This program is distributed in the hope that it will be useful,
 * but WITHOUT ANY WARRANTY; without even the implied warranty of
 * MERCHANTABILITY or FITNESS FOR A PARTICULAR PURPOSE.  See the
 * GNU General Public License for more details.
 */

&mdss_mdp {
	dsi_otm1901a_1080p_video: qcom,mdss_dsi_otm1901a_1080p_vdo {
		qcom,mdss-dsi-panel-name = "otm1901a 1080p video mode dsi panel";
		qcom,mdss-dsi-panel-controller = <&mdss_dsi0>;
		qcom,mdss-dsi-panel-type = "dsi_video_mode";
		qcom,mdss-dsi-panel-destination = "display_1";
		qcom,mdss-dsi-panel-framerate = <60>;
		qcom,mdss-dsi-virtual-channel-id = <0>;
		qcom,mdss-dsi-stream = <0>;
		qcom,mdss-dsi-panel-width = <1080>;
		qcom,mdss-dsi-panel-height = <1920>;
		qcom,mdss-dsi-h-front-porch = <52>;
		qcom,mdss-dsi-h-back-porch = <52>;
		qcom,mdss-dsi-h-pulse-width = <8>;
		qcom,mdss-dsi-h-sync-skew = <0>;
		qcom,mdss-dsi-v-back-porch = <9>;
		qcom,mdss-dsi-v-front-porch = <14>;
		qcom,mdss-dsi-v-pulse-width = <1>;
		qcom,mdss-dsi-h-left-border = <0>;
		qcom,mdss-dsi-h-right-border = <0>;
		qcom,mdss-dsi-v-top-border = <0>;
		qcom,mdss-dsi-v-bottom-border = <0>;
		qcom,mdss-dsi-bpp = <24>;
		qcom,mdss-dsi-underflow-color = <255>;
		qcom,mdss-dsi-border-color = <0>;
		qcom,mdss-dsi-on-command = [15 01 00 00 00 00 02 00 00 39 01 00 00 00 00 04 ff 19 01 01 15 01 00 00 00 00 02 00 80 39 01 00 00 00 00 03 ff 19 01 15 01 00 00 00 00 02 00 00 15 01 00 00 00 00 02 1c 33 15 01 00 00 00 00 02 00 a0 15 01 00 00 00 00 02 c1 e8 15 01 00 00 00 00 02 00 a7 15 01 00 00 00 00 02 c1 00 15 01 00 00 00 00 02 00 90 39 01 00 00 00 00 07 c0 00 2f 00 00 00 01 15 01 00 00 00 00 02 00 c0 39 01 00 00 00 00 07 c0 00 2f 00 00 00 01 15 01 00 00 00 00 02 00 9a 15 01 00 00 00 00 02 c0 1e 15 01 00 00 00 00 02 00 ac 15 01 00 00 00 00 02 c0 06 15 01 00 00 00 00 02 00 dc 15 01 00 00 00 00 02 c0 06 15 01 00 00 00 00 02 00 81 15 01 00 00 00 00 02 a5 04 15 01 00 00 00 00 02 00 84 15 01 00 00 00 00 02 c4 20 15 01 00 00 00 00 02 00 a5 15 01 00 00 00 00 02 b3 1d 15 01 00 00 00 00 02 00 92 15 01 00 00 00 00 02 e9 00 15 01 00 00 00 00 02 00 90 15 01 00 00 00 00 02 f3 01 15 01 00 00 00 00 02 00 f7 39 01 00 00 00 00 05 c3 04 18 04 04 15 01 00 00 00 00 02 00 b4 15 01 00 00 00 00 02 c0 d0 15 01 00 00 00 00 02 00 92 15 01 00 00 00 00 02 c5 e0 15 01 00 00 00 00 02 00 94 15 01 00 00 00 00 02 c5 b0 15 01 00 00 00 00 02 00 93 15 01 00 00 00 00 02 c5 32 15 01 00 00 00 00 02 00 95 15 01 00 00 00 00 02 c5 46 15 01 00 00 00 00 02 00 97 15 01 00 00 00 00 02 c5 2d 15 01 00 00 00 00 02 00 99 15 01 00 00 00 00 02 c5 41 15 01 00 00 00 00 02 00 00 39 01 00 00 00 00 03 d8 23 23 15 01 00 00 00 00 02 00 00 39 01 00 00 00 00 19 e1 00 06 0c 16 1f 26 33 46 50 62 6c 73 88 83 7e 6d 58 44 37 2e 23 0f 07 03 15 01 00 00 00 00 02 00 00 39 01 00 00 00 00 19 e2 00 06 0c 16 1f 26 33 46 50 62 6c 73 88 83 7e 6d 58 44 37 2e 23 0f 07 03 15 01 00 00 00 00 02 00 00 39 01 00 00 00 00 19 e3 00 06 0c 16 1f 26 33 46 50 62 6c 73 88 83 7e 6d 58 44 37 2e 23 0f 07 03 15 01 00 00 00 00 02 00 00 39 01 00 00 00 00 19 e4 00 06 0c 16 1f 26 33 46 50 62 6c 73 88 83 7e 6d 58 44 37 2e 23 0f 07 03 15 01 00 00 00 00 02 00 00 39 01 00 00 00 00 19 e5 00 06 0c 16 1f 26 33 46 50 62 6c 73 88 83 7e 6d 58 44 37 2e 23 0f 07 03 15 01 00 00 00 00 02 00 00 39 01 00 00 00 00 19 e6 00 06 0c 16 1f 26 33 46 50 62 6c 73 88 83 7e 6d 58 44 37 2e 23 0f 07 03 15 01 00 00 00 00 02 00 81 15 01 00 00 00 00 02 a5 07 15 01 00 00 00 00 02 00 9d 15 01 00 00 00 00 02 c5 77 15 01 00 00 00 00 02 00 b3 15 01 00 00 00 00 02 c0 cc 15 01 00 00 00 00 02 00 bc 15 01 00 00 00 00 02 c0 00 15 01 00 00 00 00 02 00 80 39 01 00 00 00 00 0f c0 00 83 00 0a 0a 00 83 0a 0a 00 83 00 0a 0a 15 01 00 00 00 00 02 00 f0 39 01 00 00 00 00 07 c3 22 02 00 00 00 0c 15 01 00 00 00 00 02 00 a0 39 01 00 00 00 00 08 c0 00 00 00 00 03 22 03 15 01 00 00 00 00 02 00 d0 39 01 00 00 00 00 08 c0 00 00 00 00 03 22 03 15 01 00 00 00 00 02 00 90 39 01 00 00 00 00 09 c2 83 01 00 00 82 01 00 00 15 01 00 00 00 00 02 00 80 39 01 00 00 00 00 0d c3 82 18 03 00 03 84 81 18 03 00 03 84 15 01 00 00 00 00 02 00 90 39 01 00 00 00 00 0d c3 00 18 03 00 03 84 01 18 03 00 03 84 15 01 00 00 00 00 02 00 80 39 01 00 00 00 00 10 cc 09 0a 11 12 13 14 15 16 17 18 28 28 28 28 28 15 01 00 00 00 00 02 00 90 39 01 00 00 00 00 10 cc 0a 09 14 13 12 11 15 16 17 18 28 28 28 28 28 15 01 00 00 00 00 02 00 a0 39 01 00 00 00 00 10 cc 1d 1e 1f 19 1a 1b 1c 20 21 22 23 24 25 26 27 15 01 00 00 00 00 02 00 b0 39 01 00 00 00 00 09 cc 01 02 03 05 06 07 04 08 15 01 00 00 00 00 02 00 c0 39 01 00 00 00 00 0d cc 00 00 00 00 00 00 00 00 00 00 00 77 15 01 00 00 00 00 02 00 d0 39 01 00 00 00 00 0d cc ff 0f 00 00 0f f0 03 00 33 03 00 77 15 01 00 00 00 00 02 00 80 39 01 00 00 00 00 10 cb 00 ff 50 50 50 00 00 00 00 00 0f 00 00 00 00 15 01 00 00 00 00 02 00 90 39 01 00 00 00 00 10 cb 00 00 00 00 00 00 00 0f ff 00 00 00 00 00 00 15 01 00 00 00 00 02 00 a0 39 01 00 00 00 00 10 cb 01 01 01 01 01 01 00 00 00 00 00 00 00 00 00 15 01 00 00 00 00 02 00 b0 39 01 00 00 00 00 10 cb 00 01 fd 00 00 00 00 00 03 00 00 00 00 00 00 15 01 00 00 00 00 02 00 c0 39 01 00 00 00 00 09 cb 00 00 00 00 00 00 77 77 15 01 00 00 00 00 02 00 d0 39 01 00 00 00 00 09 cb 00 00 00 00 00 00 77 77 15 01 00 00 00 00 02 00 e0 39 01 00 00 00 00 09 cb 00 00 00 00 00 00 77 77 15 01 00 00 00 00 02 00 f0 39 01 00 00 00 00 09 cb 01 01 01 00 00 00 77 77 15 01 00 00 00 00 02 00 80 39 01 00 00 00 00 10 cd 3f 3f 3f 3f 3f 3f 3f 3f 3f 02 12 11 3f 04 17 15 01 00 00 00 00 02 00 90 39 01 00 00 00 00 0c cd 06 18 3f 26 26 26 21 20 1f 26 26 15 01 00 00 00 00 02 00 a0 39 01 00 00 00 00 10 cd 3f 3f 3f 3f 3f 3f 3f 3f 3f 01 12 11 3f 03 17 15 01 00 00 00 00 02 00 b0 39 01 00 00 00 00 0c cd 05 18 3f 26 26 26 21 20 1f 26 26 15 01 00 00 00 00 02 00 9b 39 01 00 00 00 00 03 c5 55 55 15 01 00 00 00 00 02 00 80 15 01 00 00 00 00 02 c4 15 15 01 00 00 00 00 02 00 c1 15 01 00 00 00 00 02 c5 bb 15 01 00 00 00 00 02 00 90 15 01 00 00 00 00 02 b0 00 15 01 00 00 00 00 02 00 c2 15 01 00 00 00 00 02 b0 14 15 01 00 00 00 00 02 00 00 39 01 00 00 00 00 04 ff ff ff ff 15 01 00 00 00 00 02 35 00 15 01 00 00 78 00 02 11 00 15 01 00 00 00 00 02 00 00 39 01 00 00 00 00 04 ff 19 01 01 15 01 00 00 00 00 02 00 80 39 01 00 00 00 00 03 ff 19 01 15 01 00 00 00 00 02 00 92 39 01 00 00 00 00 05 c5 a0 19 90 2d 15 01 00 00 00 00 02 00 97 15 01 00 00 00 00 02 c5 14 15 01 00 00 00 00 02 00 99 15 01 00 00 00 00 02 c5 28 15 01 00 00 00 00 02 00 00 15 01 00 00 00 00 02 fb 01 15 01 00 00 32 00 02 29 00 15 01 00 00 00 00 02 00 00 39 01 00 00 00 00 03 99 00 00];
		qcom,mdss-dsi-off-command = [15 01 00 00 00 00 02 00 00 39 01 00 00 00 00 03 99 95 27 05 01 00 00 00 00 02 28 00 05 01 00 00 78 00 02 10 00];
		qcom,mdss-dsi-on-command-state = "dsi_lp_mode";
		qcom,mdss-dsi-off-command-state = "dsi_hs_mode";
		qcom,esd-check-enabled;
		qcom,mdss-dsi-panel-status-command = [06 01 00 01 05 00 02 0a 08];
		qcom,mdss-dsi-panel-status-command-state = "dsi_hs_mode";
		qcom,mdss-dsi-panel-status-check-mode = "reg_read";
		qcom,mdss-dsi-panel-status-read-length = <1>;
		qcom,mdss-dsi-panel-status-value = <156>;
		qcom,mdss-dsi-h-sync-pulse = <1>;
		qcom,mdss-dsi-traffic-mode = "burst_mode";
		qcom,mdss-dsi-lane-map = "lane_map_0123";
		qcom,mdss-dsi-bllp-eof-power-mode;
		qcom,mdss-dsi-bllp-power-mode;
		qcom,mdss-dsi-lp11-init;
		qcom,mdss-dsi-init-delay-us = <5>;
		qcom,mdss-dsi-lane-0-state;
		qcom,mdss-dsi-lane-1-state;
		qcom,mdss-dsi-lane-2-state;
		qcom,mdss-dsi-lane-3-state;
		qcom,mdss-dsi-te-pin-select = <1>;
		qcom,mdss-dsi-wr-mem-start = <44>;
		qcom,mdss-dsi-te-dcs-command = <1>;
		qcom,mdss-dsi-te-check-enable;
		qcom,mdss-dsi-te-using-te-pin;
		qcom,mdss-dsi-panel-timings = <0xe3342200 0x64662838 0x2b030400>;
		qcom,mdss-dsi-t-clk-post = <30>;
		qcom,mdss-dsi-t-clk-pre = <48>;
		qcom,mdss-dsi-bl-pmic-pwm-frequency = <100>;
		qcom,mdss-dsi-bl-pmic-bank-select = <0>;
		qcom,mdss-dsi-dma-trigger = "trigger_sw";
		qcom,mdss-dsi-mdp-trigger = "none";
		qcom,mdss-dsi-bl-pmic-control-type = "bl_ctrl_wled";
		qcom,mdss-dsi-bl-min-level = <1>;
		qcom,mdss-dsi-bl-max-level = <4095>;
		qcom,mdss-dsi-reset-sequence = <0x1 0x14 0x0 0x14 0x1 0x78>;
	};
};

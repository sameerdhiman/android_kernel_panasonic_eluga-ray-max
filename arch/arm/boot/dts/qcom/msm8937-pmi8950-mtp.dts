/*
 * Copyright (c) 2015-2016, The Linux Foundation. All rights reserved.
 *
 * This program is free software; you can redistribute it and/or modify
 * it under the terms of the GNU General Public License version 2 and
 * only version 2 as published by the Free Software Foundation.
 *
 * This program is distributed in the hope that it will be useful,
 * but WITHOUT ANY WARRANTY; without even the implied warranty of
 * MERCHANTABILITY or FITNESS FOR A PARTICULAR PURPOSE.  See the
 * GNU General Public License for more details.
 */

/dts-v1/;

#include "msm8937.dtsi"
#include "msm8937-pmi8950-mtp.dtsi"

/ {
	model = "Qualcomm Technologies, Inc. MSM8937-PMI8950 MTP";
	compatible = "qcom,msm8937-mtp", "qcom,msm8937", "qcom,mtp";
	qcom,board-id= <8 0>;
	qcom,pmic-id = <0x10019 0x010011 0x0 0x0>;
};

&cont_splash_mem {
	reg = <0x0 0x8dd00000 0x0 0x1400000>;
};

&clock_gcc {
	reg = <0x1800000 0x80000 0xb016000 0x40 0xb116000 0x40 0xb1d0000 0x40>;
	reg-names = "cc_base", "apcs_c1_base", "apcs_c0_base", "apcs_cci_base";
};

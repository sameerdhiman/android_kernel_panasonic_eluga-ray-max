/* Copyright (c) 2014-2015, The Linux Foundation. All rights reserved.
 *
 * This program is free software; you can redistribute it and/or modify
 * it under the terms of the GNU General Public License version 2 and
 * only version 2 as published by the Free Software Foundation.
 *
 * This program is distributed in the hope that it will be useful,
 * but WITHOUT ANY WARRANTY; without even the implied warranty of
 * MERCHANTABILITY or FITNESS FOR A PARTICULAR PURPOSE.  See the
 * GNU General Public License for more details.
 */

qcom,tinno-3000mah {
	qcom,max-voltage-uv = <4400000>;
	qcom,nom-batt-capacity-mah = <3000>;
	qcom,batt-id-kohm = <100>;
	qcom,battery-beta = <3435>;
	qcom,battery-type = "tinno-3000mah";
	qcom,chg-rslow-comp-c1 = <2784841>;
	qcom,chg-rslow-comp-c2 = <4070612>;
	qcom,chg-rs-to-rslow = <881205>;
	qcom,chg-rslow-comp-thr = <0xA8>;
	qcom,checksum = <0xE913>;
	qcom,gui-version = "PMI8950GUI - 2.0.0.15";
	qcom,fg-profile-data = <0xd9837b7c 0xdf80eb76 0x6d837376 0x9f8a4495 0xfb813b9a 0xa7bca5c8 0x5213e983 0xa17cdf80 0xc8766183 0xa6642088 0xe08f2f82 0x139a29bd 0xfbc9540e 0x6c0c8b59 0x1470b2fd 0x683da33d 0x3f290000 0x5f44c133 0x5e440000 0x0 0x0 0x2770576b 0x4b6b1688 0x8874ea63 0x4b653f7a 0xf56ff762 0x146996a9 0x173e6317 0x65a0710c 0x2800ff36 0xf0113003 0xc>;
};

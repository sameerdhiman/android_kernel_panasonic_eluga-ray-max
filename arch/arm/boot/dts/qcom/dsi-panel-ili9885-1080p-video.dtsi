/* Copyright (c) 2015-2016, The Linux Foundation. All rights reserved.
 *
 * This program is free software; you can redistribute it and/or modify
 * it under the terms of the GNU General Public License version 2 and
 * only version 2 as published by the Free Software Foundation.
 *
 * This program is distributed in the hope that it will be useful,
 * but WITHOUT ANY WARRANTY; without even the implied warranty of
 * MERCHANTABILITY or FITNESS FOR A PARTICULAR PURPOSE.  See the
 * GNU General Public License for more details.
 */

&mdss_mdp {
	dsi_ili9885_1080p_video: qcom,mdss_dsi_ili9885_1080p_video_a_si_boe_p7701 {
		qcom,mdss-dsi-panel-name = "ili9885_1080p_video_a_si_boe_p7701";
		qcom,mdss-dsi-panel-controller = <&mdss_dsi0>;
		qcom,mdss-dsi-panel-type = "dsi_video_mode";
		qcom,mdss-dsi-panel-destination = "display_1";
		qcom,mdss-dsi-panel-framerate = <60>;
		qcom,mdss-dsi-virtual-channel-id = <0>;
		qcom,mdss-dsi-stream = <0>;
		qcom,mdss-dsi-panel-width = <1080>;
		qcom,mdss-dsi-panel-height = <1920>;
		qcom,mdss-dsi-h-front-porch = <152>;
		qcom,mdss-dsi-h-back-porch = <12>;
		qcom,mdss-dsi-h-pulse-width = <8>;
		qcom,mdss-dsi-h-sync-skew = <0>;
		qcom,mdss-dsi-v-back-porch = <18>;
		qcom,mdss-dsi-v-front-porch = <4>;
		qcom,mdss-dsi-v-pulse-width = <4>;
		qcom,mdss-dsi-h-left-border = <0>;
		qcom,mdss-dsi-h-right-border = <0>;
		qcom,mdss-dsi-v-top-border = <0>;
		qcom,mdss-dsi-v-bottom-border = <0>;
		qcom,mdss-dsi-bpp = <24>;
		qcom,mdss-dsi-color-order = "rgb_swap_rgb";
		qcom,mdss-dsi-underflow-color = <255>;
		qcom,mdss-dsi-border-color = <0>;
		qcom,mdss-dsi-on-command = [29 01 00 00 00 00 04 b0 98 85 0a 29 01 00 00 00 00 08 c4 70 19 23 00 1f 1f 00 29 01 00 00 00 00 10 d0 45 05 33 eb e7 c0 88 a0 a0 03 02 84 d0 1b 10 29 01 00 00 00 00 0c d3 44 33 05 03 63 77 33 26 22 43 6e 29 01 00 00 00 00 1c dd 10 31 00 3b 33 1d 00 3c 00 3c 00 49 00 ff ff f8 e1 80 33 33 15 08 a0 01 00 71 7f 29 01 00 00 00 00 08 ec 76 1e 32 00 46 00 00 29 01 00 00 00 00 0d d6 00 00 08 17 23 65 77 44 87 00 00 09 29 01 00 00 00 00 0f d5 8b 00 00 00 01 8e 01 8e 01 4b 00 00 00 00 29 01 00 00 00 00 7b c7 00 00 00 14 00 36 00 52 00 69 00 7d 00 93 00 a2 00 b3 00 e3 01 09 01 45 01 70 01 b1 01 e5 01 e7 02 1c 02 5c 02 88 02 c6 02 ee 03 20 03 32 03 41 03 57 03 6a 03 81 03 a4 03 ce 03 ff 00 00 00 14 00 36 00 52 00 69 00 7d 00 93 00 a2 00 b3 00 e3 01 09 01 45 01 70 01 b1 01 e5 01 e7 02 1c 02 5c 02 88 02 c6 02 ee 03 20 03 32 03 41 03 57 03 6a 03 81 03 a4 03 ce 03 ff 01 01 29 01 00 00 00 00 4a e5 36 24 92 80 34 12 12 00 00 36 36 24 24 26 36 f6 f6 f6 f6 f6 36 24 9b 89 34 1b 1b 09 09 3f 3f 2d 2d 26 36 f6 f6 f6 f6 f6 04 40 90 00 68 00 00 00 00 01 01 44 00 6f 00 00 00 00 00 00 00 00 00 00 00 00 00 00 00 00 00 00 07 29 01 00 00 00 00 43 ea 70 00 03 03 00 00 00 40 00 00 00 00 00 00 0b 00 00 00 89 8a 05 05 22 0a 0a 0b 00 08 00 30 01 09 00 40 80 c0 00 00 01 23 45 67 89 ab cd ef cc cc 22 22 cc 00 00 00 00 00 00 00 00 cc cc 33 33 33 33 33 29 01 00 00 00 00 14 ee 22 10 02 06 0f 40 00 07 00 04 00 00 c0 b9 77 70 55 05 1f 29 01 00 00 00 00 04 c1 04 00 01 29 01 00 00 00 00 0a c2 10 f7 80 16 18 16 18 f3 16 29 01 00 00 00 00 0e ef 3c 05 52 13 e1 33 5b 09 00 00 00 00 00 05 01 00 00 c8 00 02 11 00 15 01 00 00 00 00 02 35 00 05 01 00 00 0a 00 02 29 00 15 01 00 00 00 00 02 b0 11];
		qcom,mdss-dsi-off-command = [05 01 00 00 32 00 02 28 00 05 01 00 00 78 00 02 10 00];
		qcom,mdss-dsi-on-command-state = "dsi_lp_mode";
		qcom,mdss-dsi-off-command-state = "dsi_hs_mode";
		qcom,esd-check-enabled;
		qcom,mdss-dsi-panel-status-command = [06 01 00 01 05 00 02 0a 08];
		qcom,mdss-dsi-panel-status-command-state = "dsi_lp_mode";
		qcom,mdss-dsi-panel-status-check-mode = "reg_read";
		qcom,mdss-dsi-panel-status-read-length = <1>;
		qcom,mdss-dsi-panel-status-value = <156>;
		qcom,mdss-dsi-h-sync-pulse = <1>;
		qcom,mdss-dsi-traffic-mode = "burst_mode";
		qcom,mdss-dsi-lane-map = "lane_map_0123";
		qcom,mdss-dsi-bllp-eof-power-mode;
		qcom,mdss-dsi-bllp-power-mode;
		qcom,mdss-dsi-lane-0-state;
		qcom,mdss-dsi-lane-1-state;
		qcom,mdss-dsi-lane-2-state;
		qcom,mdss-dsi-lane-3-state;
		qcom,mdss-dsi-panel-timings = <0x6f362400 0x666a2a3a 0x2d030400>;
		qcom,mdss-dsi-t-clk-post = <30>;
		qcom,mdss-dsi-t-clk-pre = <56>;
		qcom,mdss-dsi-bl-min-level = <1>;
		qcom,mdss-dsi-bl-max-level = <4095>;
		qcom,mdss-dsi-dma-trigger = "trigger_sw";
		qcom,mdss-dsi-mdp-trigger = "none";
		qcom,mdss-dsi-bl-pmic-control-type = "bl_ctrl_wled";
		qcom,mdss-dsi-reset-sequence = <0x1 0x14 0x0 0x14 0x1 0x78>;
	};
};
